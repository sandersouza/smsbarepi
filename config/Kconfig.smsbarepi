## config/Kconfig.smsbarepi
```kconfig
mainmenu "SMSBarePI Build Configuration"

menu "General setup"
config SMSBARE_DEBUG
    bool "Ativar DEBUG"
    default y

choice
    prompt "Boot Mode default"
    default SMSBARE_BOOT_MODE_NORM

config SMSBARE_BOOT_MODE_NONE
    bool "NONE"

config SMSBARE_BOOT_MODE_NORM
    bool "NORM"

config SMSBARE_BOOT_MODE_FAST
    bool "FAST"

config SMSBARE_BOOT_MODE_GAME
    bool "GAME"
endchoice
endmenu

menu "Build identification"
config SMSBARE_PATREON_TAG
    string "Owner tag"
    default ""
endmenu
```
